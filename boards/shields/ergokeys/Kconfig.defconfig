## boards/shields/ergokeys/Kconfig.defconfig
```kconfig
if SHIELD_ERGOKEYS_LEFT

config ZMK_KEYBOARD_NAME
    default "ErgoKeys"

config ZMK_SPLIT_ROLE_CENTRAL
    default y

endif

if SHIELD_ERGOKEYS_LEFT || SHIELD_ERGOKEYS_RIGHT

config ZMK_SPLIT
    default y

endif
```

## boards/shields/ergokeys/Kconfig.shield
```kconfig
config SHIELD_ERGOKEYS_LEFT
    def_bool $(shields_list_contains,ergokeys_left)

config SHIELD_ERGOKEYS_RIGHT
    def_bool $(shields_list_contains,ergokeys_right)
```
